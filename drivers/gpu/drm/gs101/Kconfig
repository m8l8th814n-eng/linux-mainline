## drivers/gpu/drm/gs101/Kconfig
```kconfig
# SPDX-License-Identifier: GPL-2.0-only
config DRM_GS101
	tristate "DRM support for Google gs101 (Tensor G1)"
	depends on DRM && OF
	depends on ARCH_EXYNOS || COMPILE_TEST
	select DRM_CLIENT_SELECTION
	select DRM_GEM_DMA_HELPER
	select DRM_KMS_HELPER
	help
	  Display support for the Google gs101 SoC used in Pixel 6.

	  Work in progress. DECON and DPP map their registers, take their
	  clocks and build a CRTC with one plane, driven by the frame-done
	  interrupt. There is no DSIM and no panel driver, so the panel has
	  to have been left running by the bootloader.

	  Taking the display over from simpledrm is off unless the module
	  parameter modeset=1 is given.

	  If M is selected, the module will be called gs101-drm.
```

## gps/Kconfig
```kconfig
#
# Broadcom GNSS driver support
#

config BCM_GPS_SPI_DRIVER
	tristate "Broadcom GPS SPI driver"
	depends on SPI
	help
	  Support for the Broadcom BCM4775 GNSS receiver, which hangs off SPI
	  on gs101. Says nothing about the newer integrated Kepler GNSS found
	  on zuma and later.

config BCM_GPS_PPS_DRIVER
	tristate "Broadcom GPS pulse-per-second GPIO"
	depends on BCM_GPS_SPI_DRIVER
	help
	  Exposes the receiver's 1PPS output as a GPIO-backed PPS source.
```

## gsa/Kconfig
```kconfig
# SPDX-License-Identifier: GPL-2.0

config GSA
	tristate "GSA driver"
	default n
```
